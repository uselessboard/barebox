## arch/mips/mach-loongson/Kconfig
```kconfig
if MACH_MIPS_LOONGSON

choice
	prompt "Board type"

config BOARD_LOONGSON_TECH_LS1B
	bool "Loongson Tech. LS1B demo board"
	select SYS_HAS_CPU_LOONGSON1B
	select SYS_SUPPORTS_32BIT_KERNEL
	select SYS_SUPPORTS_LITTLE_ENDIAN
	select CSRC_R4K_LIB
	select HAS_DEBUG_LL
	select DRIVER_SERIAL_NS16550
	select HAVE_PBL_IMAGE
	select HAVE_IMAGE_COMPRESSION
	select HAS_NMON

config BOARD_LOONGSON1
	bool "Loongson 1 Based boards"
	select SYS_HAS_CPU_LOONGSON1B
	select SYS_SUPPORTS_32BIT_KERNEL
	select SYS_SUPPORTS_LITTLE_ENDIAN
	select CSRC_R4K_LIB
	select HAS_DEBUG_LL
	select DRIVER_SERIAL_NS16550
	select HAVE_PBL_IMAGE
	select HAVE_IMAGE_COMPRESSION
	select HAS_NMON

endchoice

if DEBUG_LL
choice
	prompt "DEBUG_LL driver"

config DEBUG_LOONGSON1B_UART
	bool "Loongson 1B Debug UART"

config DEBUG_LOONGSON1C_UART
	bool "Loongson 1C Debug UART"

endchoice

choice
	prompt "DEBUG_LL port"

config LOONGSON1_DEBUG_LL_UART0
	depends on CPU_GS232
	bool "UART0"

config LOONGSON1_DEBUG_LL_UART1
	depends on CPU_GS232
	bool "UART1"

config LOONGSON1_DEBUG_LL_UART2
	depends on CPU_GS232
	bool "UART2"

config LOONGSON1_DEBUG_LL_UART3
	depends on CPU_GS232
	bool "UART3"

config LOONGSON1_DEBUG_LL_UART4
	depends on CPU_GS232
	bool "UART4"

endchoice
endif # DEBUG_LL

endif # MACH_MIPS_LOONGSON
```
