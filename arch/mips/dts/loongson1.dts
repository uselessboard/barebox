/dts-v1/;

#include "ls1b.dtsi"

/ {
	model = "Loongson1";
	compatible = "loongson,ls1b";

	memory@0 {
		device_type = "memory";
		reg = <0x00000000 0x4000000>;
	};
};

&serial2 {
	status = "okay";
};
